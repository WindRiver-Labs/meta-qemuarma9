## conf/layer.conf
```bitbake
#
# Copyright (C) 2013 Wind River Systems, Inc.
#

# We have a conf and classes directory, add to BBPATH
BBPATH =. "${LAYERDIR}:"

# We have a packages directory, add to BBFILES
BBFILES += "${LAYERDIR}/recipes-*/*/*.bb \
 	${LAYERDIR}/recipes-*/*/*.bbappend"

BBFILE_COLLECTIONS += "qemuarma9"
BBFILE_PATTERN_qemuarm = "^${LAYERDIR}/"
BBFILE_PRIORITY_qemuarm = "7"

# This should only be incremented on significant changes that will
# cause compatibility issues with other layers
LAYERVERSION_qemuarm = "1"

LAYERDEPENDS_qemuarm = "core"
```

## conf/machine/include/qemu.inc
```bitbake
#
# Copyright (C) 2012 Wind River Systems, Inc.
#
PCMCIA_MANAGER = "pcmciautils"
PREFERRED_PROVIDER_virtual/xserver ?= "xserver-kdrive"
PREFERRED_PROVIDER_virtual/libgl ?= "mesa-xlib"

MACHINE_FEATURES = "alsa pcmcia bluetooth irda usbgadget screen"

IMAGE_FSTYPES += "tar.bz2"

ROOT_FLASH_SIZE = "280"

# Don't include kernels in standard images
RDEPENDS_kernel-base = ""

# Use a common kernel recipe for all QEMU machines
PREFERRED_PROVIDER_virtual/kernel ?= "linux-windriver"
PREFERRED_VERSION_linux-windriver_forcevariable = "3.10%"

EXTRA_IMAGEDEPENDS += "qemu-native qemu-helper-native"
```

## conf/machine/qemuarma9.conf
```bitbake
#@TYPE: Machine
#@NAME: qemuarma9
#@DESCRIPTION: a9 vexpress

require qemuarma9.inc
require conf/machine/include/qemu.inc
DEFAULTTUNE ?= "armv7at"
require conf/machine/include/tune-cortexa9.inc

KERNEL_IMAGETYPE = "zImage"

SERIAL_CONSOLES ?= "115200;ttyAMA0 115200;ttyAMA1"

# Set image size for MMC disk
IMAGE_ROOTFS_EXTRA_SPACE = "0"
IMAGE_ROOTFS_SIZE = "3801088"
INITRAMFS_MAXSIZE = "3801088"
IMAGE_ROOTFS_ALIGNMENT = "1"

CRIU_BUILD_ARCH = "armv7"

# For runqemu
QB_SYSTEM_NAME = "qemu-system-arm"
QB_MACHINE = "-machine vexpress-a9"
QB_KERNEL_CMDLINE_APPEND = "console=ttyAMA0,115200 console=tty"
# vexpress does not have any PCI bus to support virtio-rng-pci,
# We define specific virtio block device for it.
QB_ROOTFS_OPT = "-drive id=disk0,file=@ROOTFS@,if=none,format=raw -device virtio-blk-device,drive=disk0"
QB_TAP_OPT = "-netdev tap,id=net0,ifname=@TAP@,script=no,downscript=no -device virtio-net-device,netdev=net0,mac=@MAC@"
QB_SLIRP_OPT = "-netdev user,id=net0"
QB_OPT_APPEND = "-show-cursor"
QB_DTB = "zImage-vexpress-v2p-ca9.dtb"
# Overwrite virtio-net-pci defined in oe-core/meta/classes/qemuboot.bbclass,
# since vexpress does not support it.
QB_NETWORK_DEVICE = "-device virtio-net-device,netdev=net0"
```
